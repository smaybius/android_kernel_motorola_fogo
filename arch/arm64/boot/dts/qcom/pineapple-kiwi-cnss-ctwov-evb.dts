/dts-v1/;
/plugin/;

#include "pineapple-kiwi-cnss.dtsi"

/ {
	model = "ctwov";
	compatible = "qcom,pineapple", "qcom,pineapplep";
	qcom,msm-id = <557 0x10000>, <577 0x10000>, <557 0x20000>, <577 0x20000>;
	qcom,board-id = <0x41 0x9000>;
};
